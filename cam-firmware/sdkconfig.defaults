## cam-firmware/sdkconfig.defaults
```kconfig
# Cam-firmware defaults. Run `idf.py set-target esp32p4` once before build.

CONFIG_IDF_TARGET="esp32p4"

# ── PSRAM (DFR1172 ships with 32 MB hex-mode PSRAM @ 200 MHz) ────────────
CONFIG_SPIRAM=y
CONFIG_SPIRAM_MODE_HEX=y
CONFIG_SPIRAM_SPEED_200M=y
CONFIG_SPIRAM_USE_MALLOC=y
CONFIG_SPIRAM_TRY_ALLOCATE_WIFI_LWIP=y

# ── Flash (16 MB QIO) ───────────────────────────────────────────────────
CONFIG_ESPTOOLPY_FLASHMODE_QIO=y
CONFIG_ESPTOOLPY_FLASHFREQ_80M=y
CONFIG_ESPTOOLPY_FLASHSIZE_16MB=y
CONFIG_PARTITION_TABLE_CUSTOM=y
CONFIG_PARTITION_TABLE_CUSTOM_FILENAME="partitions.csv"

# ── FreeRTOS ────────────────────────────────────────────────────────────
CONFIG_FREERTOS_UNICORE=n
CONFIG_FREERTOS_HZ=1000

# ── ESP32-C6 wireless co-processor over SDIO (esp_hosted) ──────────────
# Bring-up uses the same esp_hosted setup as the main firmware. Pin to
# the same versions as ../main/idf_component.yml to keep behavior aligned.
CONFIG_ESP_WIFI_REMOTE_ENABLED=y

# ── Logging ─────────────────────────────────────────────────────────────
CONFIG_LOG_DEFAULT_LEVEL_INFO=y
```

## sdkconfig.defaults
```kconfig
# BRL Laptimer - ESP32-P4 Waveshare 7" Touch LCD
# ESP-IDF Project Minimal Configuration (ESP-IDF 5.4+ / 6.0)

CONFIG_IDF_TARGET="esp32p4"

# Flash configuration
CONFIG_ESPTOOLPY_FLASHMODE_QIO=y
CONFIG_ESPTOOLPY_FLASHSIZE_16MB=y

# Custom partition table
CONFIG_PARTITION_TABLE_CUSTOM=y

# Compiler optimization for performance
CONFIG_COMPILER_OPTIMIZATION_PERF=y

# PSRAM (32MB hex-mode @ 200MHz)
CONFIG_SPIRAM=y
CONFIG_SPIRAM_SPEED_200M=y
CONFIG_SPIRAM_XIP_FROM_PSRAM=y

# Cache settings for optimal PSRAM performance
CONFIG_CACHE_L2_CACHE_256KB=y
CONFIG_CACHE_L2_CACHE_LINE_128B=y

# FreeRTOS
CONFIG_ESP_MAIN_TASK_STACK_SIZE=10240
CONFIG_FREERTOS_HZ=1000

# Idle-task cleanup runs FreeRTOS vTaskDelete post-processing + ESP-Hosted
# thread teardown when switching WiFi modes (AP ↔ STA). Default 1536 B
# overflows on STA connect and triggers a stack-protection fault in
# prvTaskDeleteWithCaps. Bumped to 4 KB.
CONFIG_FREERTOS_IDLE_TASK_STACKSIZE=3072

# FreeRTOS TLSP:
# - Keep CONFIG_FREERTOS_TLSP_DELETION_CALLBACKS DISABLED. When enabled,
#   the TLSP array's second half is repurposed as callback storage
#   (N/2 usable logical slots). Non-pthread tasks (lwIP in sys_arch.c,
#   WiFi driver internals) write raw data pointers into what the kernel
#   then treats as del-callback slots → on task delete FreeRTOS aborts
#   with "TLSP deletion callback at index 0 overwritten with non-executable
#   pointer 0x4800703a" exactly when switching to STA mode.
# - 2 slots (pthread + lwIP/others) is enough; pthread cleanup then uses
#   the non-callback variant which is explicitly handled in
#   pthread_internal_local_storage_destructor_callback on pthread exit.
CONFIG_FREERTOS_THREAD_LOCAL_STORAGE_POINTERS=2
# CONFIG_FREERTOS_TLSP_DELETION_CALLBACKS is not set

# ESP-Hosted SDIO queues. Default 20 overflows on large TLS downloads
# (500 KB .tbrl bundle) and triggers sdio_rx_get_buffer NULL assert on
# the first STA GET. Bumped to 30 (1.5× headroom).
# DO NOT CHANGE: tested 50 and 20 — both shift the static task buffer
# layout past valid DRAM and trigger xPortcheckValidStackMem assert in
# xTaskCreateStaticPinnedToCore during boot. 30 is the only value that
# boots reliably AND survives large TLS downloads.
CONFIG_ESP_HOSTED_SDIO_RX_Q_SIZE=30
CONFIG_ESP_HOSTED_SDIO_TX_Q_SIZE=30

# LVGL configuration
CONFIG_LV_USE_CLIB_MALLOC=y
CONFIG_LV_USE_CLIB_STRING=y
CONFIG_LV_USE_CLIB_SPRINTF=y
CONFIG_LV_DEF_REFR_PERIOD=20
CONFIG_LV_OS_FREERTOS=y
CONFIG_LV_DRAW_SW_DRAW_UNIT_CNT=1
# HARD RULE: keep this at 1. Multi-thread SW draw corrupts text on the
# PSRAM LVGL buffers (characters render as garbage until the element is
# touched/redrawn — cache-coherence race between draw threads).
# Both PPA and DRAW_UNIT_CNT=2 trigger this, so both stay off.
# Smoothness on the 1024×600 UI is achieved differently:
#   - LVGL pinned to Core 1 (main.c: task_affinity = 1)
#   - Video pipeline tasks at priority 3, below LVGL's 4 (video_mgr.cpp)
#   - Raw MJPEG passthrough (no decode/encode during recording)
# CONFIG_LVGL_PORT_ENABLE_PPA is not set
CONFIG_LV_ATTRIBUTE_FAST_MEM_USE_IRAM=y

# LVGL fonts
CONFIG_LV_FONT_MONTSERRAT_12=y
CONFIG_LV_FONT_MONTSERRAT_14=y
CONFIG_LV_FONT_MONTSERRAT_16=y
CONFIG_LV_FONT_MONTSERRAT_18=y
CONFIG_LV_FONT_MONTSERRAT_20=y
CONFIG_LV_FONT_MONTSERRAT_22=y
CONFIG_LV_FONT_MONTSERRAT_24=y
CONFIG_LV_FONT_MONTSERRAT_26=y
CONFIG_LV_FONT_MONTSERRAT_32=y
CONFIG_LV_FONT_MONTSERRAT_40=y
CONFIG_LV_FONT_MONTSERRAT_48=y
CONFIG_LV_USE_FONT_COMPRESSED=y

# ── esp_hosted: WiFi 6 + BLE 5 via ESP32-C6 co-processor (SDIO Slot 1) ──
CONFIG_ESP_WIFI_REMOTE_LIBRARY_HOSTED=y
CONFIG_ESP_HOSTED_ENABLED=y
CONFIG_ESP_HOSTED_CP_TARGET_ESP32C6=y
CONFIG_ESP_HOSTED_SDIO_HOST_INTERFACE=y
CONFIG_ESP_HOSTED_SDIO_SLOT_1=y
CONFIG_ESP_HOSTED_SDIO_4_BIT_BUS=y
CONFIG_ESP_HOSTED_SDIO_CLOCK_FREQ_KHZ=40000
CONFIG_ESP_HOSTED_SDIO_GPIO_RESET_SLAVE=54

# WiFi buffers (via esp_wifi_remote → C6)
CONFIG_ESP_WIFI_STATIC_RX_BUFFER_NUM=4
CONFIG_ESP_WIFI_DYNAMIC_RX_BUFFER_NUM=8
CONFIG_ESP_WIFI_TX_BUFFER_TYPE=1
CONFIG_ESP_WIFI_DYNAMIC_TX_BUFFER_NUM=16
CONFIG_ESP_WIFI_CACHE_TX_BUFFER_NUM=16
CONFIG_ESP_WIFI_DYNAMIC_RX_MGMT_BUF=1
CONFIG_ESP_WIFI_ESPNOW_MAX_ENCRYPT_NUM=2

# Bluetooth (NimBLE host on P4, controller on C6 via esp_hosted VHCI)
CONFIG_BT_ENABLED=y
CONFIG_BT_NIMBLE_ENABLED=y
CONFIG_BT_CONTROLLER_DISABLED=y
CONFIG_BT_NIMBLE_TRANSPORT_UART=n
CONFIG_ESP_HOSTED_ENABLE_BT_NIMBLE=y
CONFIG_ESP_HOSTED_NIMBLE_HCI_VHCI=y

# FAT filesystem — enable long filenames (session/track JSON files)
CONFIG_FATFS_LFN_HEAP=y

# ── HTTPS / TLS (car profile downloads from server) ──
CONFIG_MBEDTLS_EXTERNAL_MEM_ALLOC=y
CONFIG_MBEDTLS_SSL_IN_CONTENT_LEN=16384
CONFIG_MBEDTLS_SSL_OUT_CONTENT_LEN=4096
CONFIG_MBEDTLS_CERTIFICATE_BUNDLE=y
CONFIG_MBEDTLS_CERTIFICATE_BUNDLE_DEFAULT_CMN=y
CONFIG_SPIRAM_TRY_ALLOCATE_WIFI_LWIP=y
# Internal RAM reserved for DMA allocations (USB ISO, I2S, SDMMC).
# 128 KB is the MAXIMUM that boots reliably on ESP32-P4 with 32MB PSRAM.
# This accommodates:
#   - USB ISO transfer: ~30 KB (32 packets × 944 B)
#   - I2S mic DMA: ~16 KB (256 frames × 2 channels × 16-bit × 2 desc)
#   - SDMMC DMA: ~8 KB
#   - LVGL draw buffer: ~4 KB (if not in PSRAM)
#   - Headroom: ~70 KB for fragmentation
# MUST delete sdkconfig before rebuild: "idf.py fullclean"
CONFIG_SPIRAM_MALLOC_RESERVE_INTERNAL=98304

# ── USB Host (UVC camera for video recording) ──
CONFIG_USB_HOST_CONTROL_TRANSFER_MAX_SIZE=4096

# LVGL TJPGD — built-in JPEG decoder for camera preview & logo
CONFIG_LV_USE_TJPGD=y

# Enable experimental features (required for ESP32-P4 MIPI DSI)
CONFIG_IDF_EXPERIMENTAL_FEATURES=y
```
